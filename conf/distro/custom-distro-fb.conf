## conf/distro/custom-distro-fb.conf
```bitbake
require conf/distro/poky.conf
require conf/distro/include/base-distro.conf


DISTRO = "custom-distro-fb"
DISTRO_NAME = "Lukasz Custom Distro"
DISTRO_VERSION = "1.0-scat"


VIRTUAL-RUNTIME_init_manager = "systemd"
PREFERRED_PROVIDER_udev = "systemd"
PREFERRED_PROVIDER_udev-utils = "systemd"
DISTRO_FEATURES_BACKFILL_CONSIDERED = "sysvinit"
INIT_MANAGER = "systemd"
DISTRO_FEATURES = " systemd usrmerge opengl vulkan ptest multiarch" 
```

## conf/distro/custom-distro-wayland.conf
```bitbake
require conf/distro/poky.conf
require conf/distro/include/base-distro.conf


DISTRO = "custom-distro-wayland"
DISTRO_NAME = "Lukasz Custom Distro with Wayland GC"
DISTRO_VERSION = "1.0-scat"


VIRTUAL-RUNTIME_init_manager = "systemd"
PREFERRED_PROVIDER_udev = "systemd"
PREFERRED_PROVIDER_udev-utils = "systemd"
DISTRO_FEATURES_BACKFILL_CONSIDERED = "sysvinit"
INIT_MANAGER = "systemd"
DISTRO_FEATURES = " systemd usrmerge wayland opengl pam vulkan ptest multiarch" 
```

## conf/distro/custom-distro-x11.conf
```bitbake
require conf/distro/poky.conf
require conf/distro/include/base-distro.conf

DISTRO = "custom-distro-x11"
DISTRO_NAME = "Lukasz Custom Distro with x11 GC"

DISTRO_VERSION = "1.0-scat"
VIRTUAL-RUNTIME_init_manager = "systemd"
PREFERRED_PROVIDER_udev = "systemd"
PREFERRED_PROVIDER_udev-utils = "systemd"
DISTRO_FEATURES_BACKFILL_CONSIDERED = "sysvinit"
INIT_MANAGER = "systemd"
DISTRO_FEATURES = " systemd usrmerge x11 opengl " 
```

## conf/layer.conf
```bitbake
#
# Copyright (c) 2020-2024 Joel Winarske. All rights reserved.
#

# We have a conf and classes directory, append to BBPATH
BBPATH .= ":${LAYERDIR}"

BBFILES += " \
    ${LAYERDIR}/recipes*/*/*.bb \
    ${LAYERDIR}/recipes*/*/*.bbappend \
    ${LAYERDIR}/recipes*/*/*/*.bb \
    ${LAYERDIR}/recipes*/*/*/*.bbappend \
    ${LAYERDIR}/images/*.bb \
"

BBFILE_COLLECTIONS += "custom-layer"
BBFILE_PATTERN_custom-layer := "^${LAYERDIR}/"
BBFILE_PRIORITY_custom-layer = "12"

LAYERDEPENDS_custom-layer = "core meta-python openembedded-layer"
LAYERSERIES_COMPAT_custom-layer = "scarthgap"

BBFILES_DYNAMIC += " \          
    raspberrypi:${LAYERDIR}/dynamic-layers/meta-raspberrypi/*/*/*.bb \
    raspberrypi:${LAYERDIR}/dynamic-layers/meta-raspberrypi/*/*/*/*.bb \
    raspberrypi:${LAYERDIR}/dynamic-layers/*/*/*/*.bbappend \
    raspberrypi:${LAYERDIR}/dynamic-layers/*/*/*.bbappend \
    raspberrypi:${LAYERDIR}/dynamic-layers/*/*/*/*/*.bbappend \
    fsl-bsp-release:${LAYERDIR}/dynamic-layers/meta-imx/*/*/*.bb \
    fsl-bsp-release:${LAYERDIR}/dynamic-layers/meta-imx/*/*/*/*.bb \
    fsl-bsp-release:${LAYERDIR}/dynamic-layers/meta-imx/*/*/*.bbappend \
    fsl-bsp-release:${LAYERDIR}/dynamic-layers/meta-imx/*/*.bbappend \
    fsl-bsp-release:${LAYERDIR}/dynamic-layers/meta-imx/*/*/*/*.bbappend \
"

# backwards compatibility
BBFILE_PRIORITY_meta-custom = "12"
```
